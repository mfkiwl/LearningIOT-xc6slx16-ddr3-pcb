## AliOS-Things/app/example/Config.in
```kconfig
# --- Generated Automatically ---
config AOS_APP_EXAMPLE
    bool "Builtin Examples"

if AOS_APP_EXAMPLE
choice
    prompt "Select example"

source "app/example/blink/Config.in"
if AOS_APP_BLINK
    config AOS_BUILD_APP
        default "blink"
endif

source "app/example/linkkitapp/Config.in"
if AOS_APP_LINKKITAPP
    config AOS_BUILD_APP
        default "linkkitapp"
endif

endchoice
endif
# --- End ---
```

## AliOS-Things/board/Config.in
```kconfig
# --- Generated Automatically ---
menu "BSP         Configuration"
choice
    prompt "Select board"

source "board/stm32f401cc-lcd/Config.in"
if AOS_BOARD_STM32F401CC_LCD
    config AOS_BUILD_BOARD
        default "stm32f401cc-lcd"

    source "platform/mcu/stm32f401cx/Config.in"
    source "platform/arch/arm/armv7m/Config.in"
endif

endchoice

endmenu
# --- End ---
```

## AliOS-Things/f401ccu6/network/Config.in
```kconfig
menu "Network     Configuration"

source "network/bluetooth/breeze/Config.in"
source "network/nal/sal/Config.in"
source "network/netmgr/Config.in"
source "network/yloop/Config.in"
source "network/http/Config.in"
source "network/und/Config.in"

endmenu
```

## AliOS-Things/middleware/uagent/Config.in
```kconfig
menu "uAgent Configuration"
source "middleware/uagent/uagent/Config.in"
source "middleware/uagent/ulog/Config.in"
source "middleware/uagent/ota/Config.in"
endmenu
```

## AliOS-Things/platform/mcu/stm32f401cx/Config.in
```kconfig
config AOS_MCU_STM32F401CX
    bool
    select AOS_ARCH_ARMV7M_MK if AOS_BOARD_STM32F429ZI_MK
    select AOS_ARCH_ARMV7M if !AOS_BOARD_STM32F429ZI_MK
    select AOS_COMP_NEWLIB_STUB
    select AOS_COMP_RHINO
    help
      driver & sdk for platform/mcu stm32f401cx

if AOS_MCU_STM32F401CX
# Configurations for mcu stm32f401cx
endif
```
